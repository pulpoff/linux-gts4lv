## Documentation/devicetree/bindings/media/i2c/samsung,s5k4ha.yaml
```yaml
# SPDX-License-Identifier: (GPL-2.0-only OR BSD-2-Clause)
%YAML 1.2
---
$id: http://devicetree.org/schemas/media/i2c/samsung,s5k4ha.yaml#
$schema: http://devicetree.org/meta-schemas/core.yaml#

title: Samsung S5K4HA Image Sensor

description:
  Samsung S5K4HA image sensor is an 8MP raw image sensor. The sensor is
  controlled over a serial camera control bus protocol, the widest supported
  output image frame size is 3264x2448 at 30 frames per second, data output
  format is RAW10 transferred over 4-lane MIPI D-PHY interface.

maintainers:
  - pashkovsky@gmail.com

allOf:
  - $ref: /schemas/media/video-interface-devices.yaml#

properties:
  compatible:
    const: samsung,s5k4ha

  reg:
    maxItems: 1

  clocks:
    description: MCLK supply clock, 24 MHz.
    maxItems: 1

  reset-gpios:
    description: Active low GPIO connected to RESET pad of the sensor.
    maxItems: 1

  vdda-supply:
    description: Analogue voltage supply, 2.8 volts.

  vddd-supply:
    description: Digital core voltage supply, 1.05 or 1.2 volts.

  vddio-supply:
    description: Digital I/O voltage supply, 1.8 volts.

  port:
    $ref: /schemas/graph.yaml#/$defs/port-base
    additionalProperties: false

    properties:
      endpoint:
        $ref: /schemas/media/video-interfaces.yaml#
        unevaluatedProperties: false

        properties:
          data-lanes:
            items:
              - const: 1
              - const: 2
              - const: 3
              - const: 4

          link-frequencies:
            items:
              const: 334000000

        required:
          - data-lanes
          - link-frequencies

required:
  - compatible
  - reg
  - clocks
  - port

unevaluatedProperties: false

examples:
  - |
      #include <dt-bindings/gpio/gpio.h>

      i2c {
          #address-cells = <1>;
          #size-cells = <0>;

          camera@2d {
              compatible = "samsung,s5k4ha";
              reg = <0x2d>;
              clocks = <&camera_mclk 1>;
              assigned-clocks = <&camera_mclk 1>;
              assigned-clock-rates = <24000000>;
              reset-gpios = <&gpio1 9 GPIO_ACTIVE_LOW>;
              vdda-supply = <&vreg_cam_2p8>;
              vddd-supply = <&vreg_cam_2p8>;
              vddio-supply = <&vreg_1p8>;
              orientation = <0>;
              rotation = <270>;

              port {
                  endpoint {
                      data-lanes = <1 2 3 4>;
                      link-frequencies = /bits/ 64 <334000000>;
                      remote-endpoint = <&mipi_csi2_ep>;
                  };
              };
          };
      };
...
```
